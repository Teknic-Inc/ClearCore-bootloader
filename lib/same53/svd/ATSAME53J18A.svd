# ATSAME53J18A register map
Vendor: Microchip Technology Inc.; Series: SAME53; File version: A
Microchip ATSAME53J18A device: Cortex-M4 Microcontroller with 256KB Flash, 128KB SRAM, 64-pin package
CPU: CM4 r0p1, little endian, MPU, FPU, 3 interrupt priority bits, 137 interrupts
Registers are 32-bit, read-write, reset 0x0 unless marked. A register's access mark holds for its fields unless they carry their own. Offsets are from the block's base; lines under a group give offsets from that group; [hi:lo] are bit positions; {n}, {i} and the like mark numbered series; 'fields as' and 'values as' point back to an identical list; <NAME> marks a mode.

## Memory map
0x40000000 PAC size 0x80 — Peripheral Access Controller
0x40000400 PM size 0x40 — Power Manager
0x40000800 MCLK size 0x80 — Main Clock
0x40000C00 RSTC size 0x20 — Reset Controller
0x40001000 OSCCTRL size 0x100 — Oscillators Control
0x40001400 OSC32KCTRL size 0x40 — 32kHz Oscillators Control
0x40001800 SUPC size 0x80 — Supply Controller
0x40001C00 GCLK size 0x400 — Generic Clock Generator
0x40002000 WDT size 0x10 — Watchdog Timer
0x40002400 RTC size 0x100 — Real-Time Counter
0x40002800 EIC size 0x40 — External Interrupt Controller
0x40002C00 FREQM size 0x20 — Frequency Meter
0x40003000 SERCOM0 size 0x40 — Serial Communication Interface 0
0x40003400 SERCOM1 size 0x40 — Serial Communication Interface 1
0x40003800 TC0 size 0x40 — Basic Timer Counter 0
0x40003C00 TC1 size 0x40 — Basic Timer Counter 1
0x41000000 USB size 0x400 — Universal Serial Bus
0x41002000 DSU size 0x2000 — Device Service Unit
0x41004000 NVMCTRL size 0x80 — Non-Volatile Memory Controller
0x41006000 CMCC size 0x40 — Cortex M Cache Controller
0x41008000 PORT size 0x200 — Port Module
0x4100A000 DMAC size 0x400 — Direct Memory Access Controller
0x4100C000 HMATRIX size 0x180 — HSB Matrix
0x4100E000 EVSYS size 0x400 — Event System Interface
0x41012000 SERCOM2 size 0x40 — Serial Communication Interface 2
0x41014000 SERCOM3 size 0x40 — Serial Communication Interface 3
0x41016000 TCC0 size 0x90 — Timer Counter Control 0
0x41018000 TCC1 size 0x90 — Timer Counter Control 1
0x4101A000 TC2 size 0x40 — Basic Timer Counter 2
0x4101C000 TC3 size 0x40 — Basic Timer Counter 3
0x41020000 RAMECC size 0x10
0x42000800 GMAC size 0x280 — Ethernet MAC
0x42000C00 TCC2 size 0x90 — Timer Counter Control 2
0x42001000 TCC3 size 0x90 — Timer Counter Control 3
0x42001400 TC4 size 0x40 — Basic Timer Counter 4
0x42001800 TC5 size 0x40 — Basic Timer Counter 5
0x42001C00 PDEC size 0x40 — Quadrature Decodeur
0x42002000 AC size 0x40 — Analog Comparators
0x42002400 AES size 0x100 — Advanced Encryption Standard
0x42002800 TRNG size 0x40 — True Random Generator
0x42002C00 ICM size 0x80 — Integrity Check Monitor
0x42003400 QSPI size 0x80 — Quad SPI interface
0x42003800 CCL size 0x40 — Configurable Custom Logic
0x43000000 SERCOM4 size 0x40 — Serial Communication Interface 4
0x43000400 SERCOM5 size 0x40 — Serial Communication Interface 5
0x43001000 TCC4 size 0x90 — Timer Counter Control 4
0x43001C00 ADC0 size 0x80 — Analog Digital Converter 0
0x43002000 ADC1 size 0x80 — Analog Digital Converter 1
0x43002400 DAC size 0x20 — Digital-to-Analog Converter
0x43002800 I2S size 0x40 — Inter-IC Sound Interface
0x43002C00 PCC size 0x100 — Parallel Capture Controller
0x45000000 SDHC0 size 0xC00 — SD/MMC Host Controller

## Interrupts
0 PM
1 MCLK
2 OSCCTRL_XOSC0 (OSCCTRL)
3 OSCCTRL_XOSC1 (OSCCTRL)
4 OSCCTRL_DFLL (OSCCTRL)
5 OSCCTRL_DPLL0 (OSCCTRL)
6 OSCCTRL_DPLL1 (OSCCTRL)
7 OSC32KCTRL
8 SUPC_OTHER (SUPC)
9 SUPC_BODDET (SUPC)
10 WDT
11 RTC
{n+12} EIC_EXTINT_{n} (EIC) (n=0..15)
28 FREQM
29 NVMCTRL_0 (NVMCTRL)
30 NVMCTRL_1 (NVMCTRL)
31 DMAC_0 (DMAC)
32 DMAC_1 (DMAC)
33 DMAC_2 (DMAC)
34 DMAC_3 (DMAC)
35 DMAC_OTHER (DMAC)
36 EVSYS_0 (EVSYS)
37 EVSYS_1 (EVSYS)
38 EVSYS_2 (EVSYS)
39 EVSYS_3 (EVSYS)
40 EVSYS_OTHER (EVSYS)
41 PAC
45 RAMECC
46 SERCOM0_0 (SERCOM0)
47 SERCOM0_1 (SERCOM0)
48 SERCOM0_2 (SERCOM0)
49 SERCOM0_OTHER (SERCOM0)
50 SERCOM1_0 (SERCOM1)
51 SERCOM1_1 (SERCOM1)
52 SERCOM1_2 (SERCOM1)
53 SERCOM1_OTHER (SERCOM1)
54 SERCOM2_0 (SERCOM2)
55 SERCOM2_1 (SERCOM2)
56 SERCOM2_2 (SERCOM2)
57 SERCOM2_OTHER (SERCOM2)
58 SERCOM3_0 (SERCOM3)
59 SERCOM3_1 (SERCOM3)
60 SERCOM3_2 (SERCOM3)
61 SERCOM3_OTHER (SERCOM3)
62 SERCOM4_0 (SERCOM4)
63 SERCOM4_1 (SERCOM4)
64 SERCOM4_2 (SERCOM4)
65 SERCOM4_OTHER (SERCOM4)
66 SERCOM5_0 (SERCOM5)
67 SERCOM5_1 (SERCOM5)
68 SERCOM5_2 (SERCOM5)
69 SERCOM5_OTHER (SERCOM5)
80 USB_OTHER (USB)
81 USB_SOF_HSOF (USB)
82 USB_TRCPT0 (USB)
83 USB_TRCPT1 (USB)
84 GMAC
85 TCC0_OTHER (TCC0)
86 TCC0_MC0 (TCC0)
87 TCC0_MC1 (TCC0)
88 TCC0_MC2 (TCC0)
89 TCC0_MC3 (TCC0)
90 TCC0_MC4 (TCC0)
91 TCC0_MC5 (TCC0)
92 TCC1_OTHER (TCC1)
93 TCC1_MC0 (TCC1)
94 TCC1_MC1 (TCC1)
95 TCC1_MC2 (TCC1)
96 TCC1_MC3 (TCC1)
97 TCC2_OTHER (TCC2)
98 TCC2_MC0 (TCC2)
99 TCC2_MC1 (TCC2)
100 TCC2_MC2 (TCC2)
101 TCC3_OTHER (TCC3)
102 TCC3_MC0 (TCC3)
103 TCC3_MC1 (TCC3)
104 TCC4_OTHER (TCC4)
105 TCC4_MC0 (TCC4)
106 TCC4_MC1 (TCC4)
107 TC0
108 TC1
109 TC2
110 TC3
111 TC4
112 TC5
115 PDEC_OTHER (PDEC)
116 PDEC_MC0 (PDEC)
117 PDEC_MC1 (PDEC)
118 ADC0_OTHER (ADC0)
119 ADC0_RESRDY (ADC0)
120 ADC1_OTHER (ADC1)
121 ADC1_RESRDY (ADC1)
122 AC
123 DAC_OTHER (DAC)
124 DAC_EMPTY_0 (DAC)
125 DAC_EMPTY_1 (DAC)
126 DAC_RESRDY_0 (DAC)
127 DAC_RESRDY_1 (DAC)
128 I2S
129 PCC
130 AES
131 TRNG
132 ICM
134 QSPI
135 SDHC0

## Licence text in the file
Copyright (c) 2018 Microchip Technology Inc. . SPDX-License-Identifier: Apache-2.0 . Licensed under the Apache License, Version 2.0 (the "License"); you may not use this file except in compliance with the License. You may obtain a copy of the License at http://www.apache.org/licenses/LICENSE-2.0 . Unless required by applicable law or agreed to in writing, software distributed under the License is distributed on an "AS IS" BASIS, WITHOUT WARRANTIES OR CONDITIONS OF ANY KIND, either express or implied. See the License for the specific language governing permissions and limitations under the License.
