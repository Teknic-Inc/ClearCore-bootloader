# ATSAME53N20A device description
Architecture: CORTEX-M4; Family: SAME; Series: SAME53
Parameters: GCLK_ID_TRACE=47 (Index of Trace Generic Clock), NUM_IRQ=137 (Number of interrupt request lines), __CM4_REV=0x0001 (Cortex-M4 Core Revision), __DEBUG_LVL=3 (Debug Level), __FPU_PRESENT=1 (FPU present or not), __MPU_PRESENT=1 (MPU present or not), __NVIC_PRIO_BITS=3 (Number of Bits used for Priority Levels), __TRACE_LVL=2 (Trace Level), __VTOR_PRESENT=1 (Vector Table Offset Register present or not), __Vendor_SysTickConfig=0 (Set to 1 if different SysTick Config is used), __ARCH_ARM=1, __ARCH_ARM_CORTEX_M=1, __DEVICE_IS_SAM=1
Programming and debug interfaces: SWD
Registers are 32-bit, read-write, reset 0x0 unless marked. A register's access mark holds for its fields unless they carry their own. Offsets are from the block's base; lines under a group give offsets from that group; [hi:lo] are bit positions; {n}, {i} and the like mark numbered series; 'fields as' and 'values as' point back to an identical list; <NAME> marks a mode.

## Ordering variants
ATSAME53N20A-AU: TQFP100, pinout SAMD51N, up to 120 MHz, -40 to 85 C, 1.71 to 3.60 V
ATSAME53N20A-AF: TQFP100, pinout SAMD51N, up to 120 MHz, -40 to 125 C, 1.71 to 3.60 V

## Memory
base space: start 0 size 0x100000000, little endian
  0x00000000 FLASH size 0x100000 flash, rw, executable, page 512
  0x00800080 SW0 size 0x10 fuses, ro
  0x00800100 TEMP_LOG size 0x200 fuses, rw, page 512
  0x03000000 CMCC size 0x1000000 io, rw
  0x3000000 CMCC_DATARAM size 0x1000 io, rw
  0x3001000 CMCC_TAGRAM size 0x400 io, rw
  0x3002000 CMCC_VALIDRAM size 0x40 io, rw
  0x04000000 QSPI size 0x1000000 other, rw, executable, external
  0x20000000 HSRAM size 0x40000 ram, rw, executable
  0x20000000 HSRAM_ETB size 0x8000 ram, rw, executable
  0x20000000 HSRAM_RET1 size 0x8000 ram, rw, executable
  0x40000000 HPB0 size 0x4400 io, rw
  0x41000000 HPB1 size 0x22000 io, rw
  0x42000000 HPB2 size 0x3C00 io, rw
  0x43000000 HPB3 size 0x3000 io, rw
  0x44000000 SEEPROM size 0x20000 io, rw
  0x45000000 SDHC0 size 0xC00 io, rw
  0x46000000 SDHC1 size 0xC00 io, rw
  0x47000000 BKUPRAM size 0x2000 ram, rw, executable
  0xE0000000 PPB size 0x100000 io, rw
  0xE000E000 SCS size 0x00001000 io, rw
fuses space: start 0x00000000 size 0x20000000, little endian

## Peripheral instances (address, pins/pin function, parameters)
AC at 0x42002000
  pins: AIN0 PA04/B; AIN1 PA05/B; AIN2 PA06/B; AIN3 PA07/B; CMP0 PA12/M set 1 or PA18/M set 2 or PB24/M set 3; CMP1 PA13/M set 1 or PA19/M set 2 or PB25/M set 3
  parameters: COMPCTRL_MUXNEG_OPAMP=7 (OPAMP selection for MUXNEG), GCLK_ID=32 (Index of Generic Clock), IMPLEMENTS_VDBLR=0 (VDoubler implemented ?), NUM_CMP=2 (Number of comparators), PAIRS=1 (Number of pairs of comparators), SPEED_LEVELS=2 (Number of speed values), INSTANCE_ID=72
ADC0 at 0x43001C00 (ADC)
  pins: AIN0 PA02/B; AIN1 PA03/B; AIN2 PB08/B; AIN3 PB09/B; AIN{n} PA{n:02}/B (n=4..11); AIN12 PB00/B; AIN13 PB01/B; AIN14 PB02/B; AIN15 PB03/B; DRV0 PA03/O; DRV1 PB08/O; DRV2 PB09/O; DRV3 PA04/O; DRV4 PA06/O; DRV5 PA07/O; DRV6 PA08/O; DRV7 PA09/O; DRV8 PA10/O; DRV9 PA11/O; DRV{n} PA{n+6}/O (n=10..17); DRV18 PA27/O; DRV19 PA30/O; DRV20 PB02/O; DRV21 PB03/O; DRV22 PB04/O; DRV23 PB05/O; DRV24 PB06/O; DRV25 PB07/O; DRV26 PB12/O; DRV27 PB13/O; DRV28 PB14/O; DRV29 PB15/O; DRV30 PB00/O; DRV31 PB01/O; X0 PA03/B; Y0 PA03/B; X1 PB08/B; Y1 PB08/B; X2 PB09/B; Y2 PB09/B; X3 PA04/B; Y3 PA04/B; X4 PA06/B; Y4 PA06/B; X5 PA07/B; Y5 PA07/B; X6 PA08/B; Y6 PA08/B; X7 PA09/B; Y7 PA09/B; X8 PA10/B; Y8 PA10/B; X9 PA11/B; Y9 PA11/B; X{n} PA{n+6}/B (n=10..17); Y{n} PA{n+6}/B (n=10..17); X18 PA27/B; Y18 PA27/B; X19 PA30/B; Y19 PA30/B; X20 PB02/B; Y20 PB02/B; X21 PB03/B; Y21 PB03/B; X22 PB04/B; Y22 PB04/B; X23 PB05/B; Y23 PB05/B; X24 PB06/B; Y24 PB06/B; X25 PB07/B; Y25 PB07/B; X26 PB12/B; Y26 PB12/B; X27 PB13/B; Y27 PB13/B; X28 PB14/B; Y28 PB14/B; X29 PB15/B; Y29 PB15/B; X30 PB00/B; Y30 PB00/B; X31 PB01/B; Y31 PB01/B
  parameters: BANDGAP=27 (MUXPOS value to select BANDGAP), CTAT=29 (MUXPOS value to select CTAT), DMAC_ID_RESRDY=68 (index of DMA RESRDY trigger), DMAC_ID_SEQ=69 (Index of DMA SEQ trigger), EXTCHANNEL_MSB=15 (Number of external channels), GCLK_ID=40 (index of Generic Clock), MASTER_SLAVE_MODE=1 (ADC Master/Slave Mode), OPAMP2=0 (MUXPOS value to select OPAMP2), OPAMP01=0 (MUXPOS value to select OPAMP01), PTAT=28 (MUXPOS value to select PTAT), TOUCH_IMPLEMENTED=1 (TOUCH implemented or not), TOUCH_LINES_NUM=32 (Number of touch lines), INSTANCE_ID=103
ADC1 at 0x43002000 (ADC)
  pins: AIN0 PB08/B; AIN1 PB09/B; AIN2 PA08/B; AIN3 PA09/B; AIN4 PC02/B; AIN5 PC03/B; AIN6 PB04/B; AIN7 PB05/B; AIN8 PB06/B; AIN9 PB07/B; AIN10 PC00/B; AIN11 PC01/B
  parameters: BANDGAP=27 (MUXPOS value to select BANDGAP), CTAT=29 (MUXPOS value to select CTAT), DMAC_ID_RESRDY=70 (Index of DMA RESRDY trigger), DMAC_ID_SEQ=71 (Index of DMA SEQ trigger), EXTCHANNEL_MSB=15 (Number of external channels), GCLK_ID=41 (Index of Generic Clock), MASTER_SLAVE_MODE=2 (ADC Master/Slave Mode), OPAMP2=0 (MUXPOS value to select OPAMP2), OPAMP01=0 (MUXPOS value to select OPAMP01), PTAT=28 (MUXPOS value to select PTAT), TOUCH_IMPLEMENTED=0 (TOUCH implemented or not), TOUCH_LINES_NUM=1 (Number of touch lines), INSTANCE_ID=104
AES at 0x42002400
  parameters: DMAC_ID_RD=82 (DMA DATA Read trigger), DMAC_ID_WR=81 (DMA DATA Write trigger), FOUR_BYTE_OPERATION=1 (Byte Operation), GCM=1, KEYLEN=2 (Key Length), INSTANCE_ID=73
CCL at 0x42003800
  pins: IN0 PA04/N or PA16/N or PB22/N; IN1 PA05/N or PA17/N or PB00/N; IN2 PA06/N or PA18/N or PB01/N; IN3 PA08/N or PA30/N; IN4 PA09/N or PC27/N; IN5 PA10/N or PC28/N; IN6 PA22/N or PB06/N; IN7 PA23/N or PB07/N; IN8 PA24/N or PB08/N; IN9 PB14/N or PC20/N; IN10 PB15/N or PC21/N; IN11 PB10/N or PB16/N; OUT0 PA07/N or PA19/N or PB02/N or PB23/N; OUT1 PA11/N or PA31/N or PB11/N; OUT2 PA25/N or PB09/N; OUT3 PB17/N
  parameters: GCLK_ID=33 (GCLK index for CCL), LUT_NUM=4 (Number of LUT in a CCL), SEQ_NUM=2 (Number of SEQ in a CCL), INSTANCE_ID=78
CMCC at 0x41006000
  parameters: INSTANCE_ID=35
DAC at 0x43002400
  pins: VOUT0 PA02/B; VOUT1 PA05/B
  parameters: CHANNEL_SIZE=2 (Number of DACs), DATA_SIZE=12 (Number of bits in data), GCLK_ID=42 (Index of Generic Clock), STEP=7 (Number of steps to reach full scale), INSTANCE_ID=105
DMAC at 0x4100A000
  parameters: BURST=1 (0: no burst support; 1: burst support), CH_BITS=5 (Number of bits to select channel), CH_NUM=32 (Number of channels), EVIN_NUM=8 (Number of input events), EVOUT_NUM=4 (Number of output events), FIFO_SIZE=16 (FIFO size for burst mode.), LVL_BITS=2 (Number of bits to select level priority), LVL_NUM=4 (Enable priority level number), QOSCTRL_D_RESETVALUE=2 (QOS dmac ahb interface reset value), QOSCTRL_F_RESETVALUE=2 (QOS dmac fetch interface reset value), QOSCTRL_WRB_RESETVALUE=2 (QOS dmac write back interface reset value), TRIG_BITS=7 (Number of bits to select trigger source), TRIG_NUM=85 (Number of peripheral triggers), INSTANCE_ID=37
DSU at 0x41002000
  parameters: DMAC_ID_DCC0=2 (DMAC ID for DCC0 register), DMAC_ID_DCC1=3 (DMAC ID for DCC1 register), INSTANCE_ID=33
EIC at 0x40002800
  pins: EXTINT0 PA00/A or PA16/A or PB00/A or PB16/A or PC00/A or PC16/A; EXTINT1 PA01/A or PA17/A or PB01/A or PB17/A or PC01/A or PC17/A; EXTINT2 PA02/A or PA18/A or PB02/A or PB18/A or PC02/A or PC18/A; EXTINT3 PA03/A or PA19/A or PB03/A or PB19/A or PC03/A or PC19/A; EXTINT4 PA04/A or PA20/A or PB04/A or PB20/A or PC20/A; EXTINT5 PA05/A or PA21/A or PB05/A or PB21/A or PC05/A or PC21/A; EXTINT6 PA06/A or PA22/A or PB06/A or PB22/A or PC06/A; EXTINT7 PA07/A or PA23/A or PB07/A or PB23/A; EXTINT8 PA24/A or PB08/A or PB24/A or PC24/A; EXTINT9 PA09/A or PA25/A or PB09/A or PB25/A or PC07/A or PC25/A; EXTINT10 PA10/A or PB10/A or PC10/A or PC26/A; EXTINT11 PA11/A or PA27/A or PB11/A or PC11/A or PC27/A; EXTINT12 PA12/A or PB12/A or PC12/A or PC28/A; EXTINT13 PA13/A or PB13/A or PC13/A; EXTINT14 PA30/A or PB14/A or PB30/A or PC14/A or PA14/A; EXTINT15 PA15/A or PA31/A or PB15/A or PB31/A or PC15/A; NMI PA08/A
  parameters: EXTINT_NUM=16 (Number of external interrupts), GCLK_ID=4 (Generic Clock index), NUMBER_OF_CONFIG_REGS=2 (Number of CONFIG registers), NUMBER_OF_DPRESCALER_REGS=2 (Number of DPRESCALER pin groups), NUMBER_OF_INTERRUPTS=16 (Number of external interrupts (obsolete)), INSTANCE_ID=10
EVSYS at 0x4100E000
  parameters: ASYNCHRONOUS_CHANNELS=0xFFFFF000 (Mask of Only Asynchronous Channels), CHANNELS=32 (Total Number of Channels), CHANNELS_BITS=5 (Number of bits to select Channel), EXTEVT_NUM=0 (Number of External Event Generators), GCLK_ID_{n}={n+11} (Index of Generic Clock {n}) (n=0..11), GENERATORS=119 (Total Number of Event Generators), GENERATORS_BITS=7 (Number of bits to select Event Generator), SYNCH_NUM=12 (Number of Synchronous Channels), SYNCH_NUM_BITS=4 (Number of bits to select Synchronous Channels), USERS=67 (Total Number of Event Users), USERS_BITS=7 (Number of bits to select Event User), INSTANCE_ID=39
FREQM at 0x40002C00
  parameters: GCLK_ID_MSR=5 (Index of measure generic clock), INSTANCE_ID=11
GCLK at 0x40001C00
  pins: IO0 PA30/M or PB14/M or PA14/M or PB22/M; IO1 PB15/M or PA15/M or PB23/M or PA27/M; IO2 PA16/M or PB16/M; IO3 PA17/M or PB17/M; IO4 PA10/M or PB10/M or PB18/M; IO5 PA11/M or PB11/M or PB19/M; IO6 PB12/M or PB20/M; IO7 PB13/M or PB21/M
  parameters: GENCTRL0_RESETVALUE=106 (Default specific reset value for generator 0), GENDIV_BITS=16, GEN_BITS=4, GEN_NUM=12 (Number of Generic Clock Generators), GEN_NUM_MSB=11 (Number of Generic Clock Generators - 1), GEN_SOURCE_NUM_MSB=8 (Number of Generic Clock Sources - 1), IO_NUM=8 (Number of Generic Clock I/Os), NUM=48 (Number of Generic Clock Users), SOURCE_BITS=4, SOURCE_NUM=9 (Number of Generic Clock Sources), INSTANCE_ID=7
GMAC at 0x42000800
  pins: GCOL PC21/L; GCRS PA16/L; GMDC PA20/L set 4 or PB14/L set 1 or PC11/L set 2; GMDIO PA21/L set 4 or PB15/L set 1 or PC12/L set 2; GRX0 PA13/L; GRX1 PA12/L; GRX2 PC15/L; GRX3 PC14/L; GRXCK PC18/L; GRXDV PC20/L; GRXER PA15/L; GTX0 PA18/L; GTX1 PA19/L; GTX2 PC16/L; GTX3 PC17/L; GTXCK PA14/L; GTXEN PA17/L; GTXER PC19/L
  parameters: INSTANCE_ID=66
HMATRIX at 0x4100C000 (HMATRIXB)
  parameters: MASTER_NUM=8, MASTER_CM4_S=0, MASTER_CMCC=1, MASTER_PICOP_MEM=2, MASTER_PICOP_IO=3, MASTER_DMAC_DTWR=4, MASTER_DMAC_DTRD=5, MASTER_ICM=6, MASTER_DSU=7, SLAVE_NUM=15, SLAVE_FLASH=0, SLAVE_FLASH_ALT=1, SLAVE_SEEPROM=2, SLAVE_RAMCM4S=3, SLAVE_RAMPPPDSU=4, SLAVE_RAMDMAWR=5, SLAVE_RAMDMACICM=6, SLAVE_HPB0=7, SLAVE_HPB1=8, SLAVE_HPB2=9, SLAVE_HPB3=10, SLAVE_SDHC0=12, SLAVE_SDHC1=13, SLAVE_QSPI=14, SLAVE_BKUPRAM=15, INSTANCE_ID=38
ICM at 0x42002C00
  parameters: INSTANCE_ID=75
I2S at 0x43002800
  pins: FS0 PA09/J set 1 or PA20/J set 2; FS1 PA23/J set 2 or PB11/J set 1; MCK0 PA08/J set 1 or PB17/J set 2; MCK1 PB13/J set 1; SCK0 PA10/J set 1 or PB16/J set 2; SCK1 PB12/J set 1; SDI PA22/J set 2 or PB10/J set 1; SDO PA11/J set 1 or PA21/J set 2
  parameters: CLK_NUM=2 (Number of clock units), GCLK_ID_0=43 (Index of Generic Clock 0), GCLK_ID_1=44 (Index of Generic Clock 1), MAX_SLOTS=8 (Max number of data slots in frame), MAX_WL_BITS=32 (Max number of bits in data samples), SER_NUM=2 (Number of serializers), INSTANCE_ID=106
MCLK at 0x40000800
  parameters: SYSTEM_CLOCK=48000000 (System Clock Frequency at Reset), INSTANCE_ID=2
  clocks: AHB HPB0 bit 0, HPB1 bit 1, HPB2 bit 2, HPB3 bit 3, DSU bit 4, HMATRIX bit 5, NVMCTRL bit 6, HSRAM bit 7, CMCC bit 8, DMAC bit 9, USB bit 10, BKUPRAM bit 11, PAC bit 12, QSPI bit 13, GMAC bit 14, SDHC0 bit 15, SDHC1 bit 16, ICM bit 19, PUKCC bit 20, QSPI_2X bit 21, NVMCTRL_SMEEPROM bit 22, NVMCTRL_CACHE bit 23
NVMCTRL at 0x41004000
  parameters: BLOCK_SIZE=8192 (Size Of Block (Bytes, Smallest Granularity for Erase Operation)), FLASH_SIZE=1048576, PAGES=2048, PAGES_PR_REGION=128, PSM_0_FRMFW_FWS_1_MAX_FREQ=12000000, PSM_0_FRMLP_FWS_0_MAX_FREQ=18000000, PSM_0_FRMLP_FWS_1_MAX_FREQ=36000000, PSM_0_FRMHS_FWS_0_MAX_FREQ=25000000, PSM_0_FRMHS_FWS_1_MAX_FREQ=50000000, PSM_1_FRMFW_FWS_1_MAX_FREQ=12000000, PSM_1_FRMLP_FWS_0_MAX_FREQ=8000000, PSM_1_FRMLP_FWS_1_MAX_FREQ=12000000, INSTANCE_ID=34
FUSES at SW0_FUSES 0x00800080 in fuses, TEMP_LOG_FUSES 0x00800100 in fuses, USER_FUSES 0x00804000 in fuses
OSCCTRL at 0x40001000
  pins: XIN0 PA14/XIN0; XIN1 PB22/XIN1; XOUT0 PA15/XOUT0; XOUT1 PB23/XOUT1
  parameters: DFLLS_NUM=1 (Number of DFLLs), DFLL_IMPLEMENTED=1, DFLL48M_BIASTESTPT_IMPLEMENTED=0 (DFLL48M bias test mode implemented), DFLL48M_CDACSTEPSIZE_SIZE=2 (Size COARSE DAC STEP), DFLL48M_COARSE_RESET_VALUE=32 (DFLL48M Frequency Coarse Reset Value (Before Calibration)), DFLL48M_COARSE_SIZE=6 (Size COARSE CALIBRATION), DFLL48M_ENABLE_RESET_VALUE=1 (Run oscillator at reset), DFLL48M_FDACSTEPSIZE_SIZE=2 (Size FINE DAC STEP), DFLL48M_FINE_RESET_VALUE=128 (DFLL48M Frequency Fine Reset Value (Before Calibration)), DFLL48M_FINE_SIZE=8 (Size FINE CALIBRATION), DFLL48M_ONDEMAND_RESET_VALUE=1 (Run oscillator always or only when requested), DFLL48M_RUNSTDBY_RESET_VALUE=0 (Run oscillator even if standby mode), DFLL48M_TCAL_SIZE=4 (Size TEMP CALIBRATION), DFLL48M_TCBIAS_SIZE=2 (Size TC BIAS CALIBRATION), DFLL48M_TESTPTSEL_SIZE=3 (Size TEST POINT SELECTOR), DFLL48M_WAITLOCK_ACTIVE=1 (Enable Wait Lock Feature), DPLLS_NUM=2 (Number of DPLLs), DPLL0_IMPLEMENTED=1, DPLL0_I12ND_I12NDFRAC_PAD_CONTROL=0 (NOT_IMPLEMENTED: The ND and NDFRAC pad tests are not used, use registers instead), DPLL0_OCC_IMPLEMENTED=1, DPLL1_IMPLEMENTED=1, DPLL1_I12ND_I12NDFRAC_PAD_CONTROL=0 (NOT_IMPLEMENTED: The ND and NDFRAC pad tests are not used, use registers instead), DPLL1_OCC_IMPLEMENTED=0, GCLK_ID_DFLL48=0 (Index of Generic Clock for DFLL48), GCLK_ID_FDPLL0=1 (Index of Generic Clock for DPLL0), GCLK_ID_FDPLL1=2 (Index of Generic Clock for DPLL1), GCLK_ID_FDPLL032K=3 (Index of Generic Clock for DPLL0 32K), GCLK_ID_FDPLL132K=3 (Index of Generic Clock for DPLL1 32K), OSC16M_IMPLEMENTED=0, OSC48M_IMPLEMENTED=0, OSC48M_NUM=1, RCOSCS_NUM=1 (Number of RCOSCs (min 1)), XOSCS_NUM=2 (Number of XOSCs), XOSC0_CFD_CLK_SELECT_SIZE=4 (Clock fail prescaler size), XOSC0_CFD_IMPLEMENTED=1 (Clock fail detected for xosc implemented), XOSC0_IMPLEMENTED=1, XOSC0_ONDEMAND_RESET_VALUE=1 (Run oscillator always or only when requested), XOSC0_RUNSTDBY_RESET_VALUE=0 (Run oscillator even if standby mode), XOSC1_CFD_CLK_SELECT_SIZE=4 (Clock fail prescaler size), XOSC1_CFD_IMPLEMENTED=1 (Clock fail detected for xosc implemented), XOSC1_IMPLEMENTED=1, XOSC1_ONDEMAND_RESET_VALUE=1 (Run oscillator always or only when requested), XOSC1_RUNSTDBY_RESET_VALUE=0 (Run oscillator even if standby mode), DFLL48M_VERSION=0x100, FDPLL_VERSION=0x100, XOSC_VERSION=0x100, INSTANCE_ID=4
OSC32KCTRL at 0x40001400
  pins: XIN32 PA00/XIN32; XOUT32 PA01/XOUT32
  parameters: OSC32K_COARSE_CALIB_MSB=0 (OSC32K coarse calibration size), INSTANCE_ID=5
PAC at 0x40000000
  parameters: HPB_NUM=4 (Number of bridges AHB/APB), INSTANCE_ID=0
PCC at 0x43002C00
  pins: CLK PA14/K; DATA{n} PA{n+16}/K (n=0..7); DATA8 PB14/K; DATA9 PB15/K; DATA10 PC12/K; DATA11 PC13/K; DATA12 PC14/K; DATA13 PC15/K; DEN1 PA12/K; DEN2 PA13/K
  parameters: DATA_SIZE=14, DMAC_ID_RX=80, INSTANCE_ID=107
PDEC at 0x42001C00
  pins: QDI0 PB18/G set 2 or PB23/G set 4 or PC16/G set 1 or PA24/G set 3; QDI1 PB19/G set 2 or PB24/G set 4 or PC17/G set 1 or PA25/G set 3; QDI2 PB20/G set 2 or PB25/G set 4 or PC18/G set 1 or PB22/G set 3
  parameters: CC_NUM=2 (Number of Compare Channels units), GCLK_ID=31, INSTANCE_ID=71
PM at 0x40000400
  pins: RESET_N RESET_N
  parameters: PD_NUM=0 (Number of switchable Power Domains), INSTANCE_ID=1
PORT at 0x41008000
  pins: P{n} PA{n:02} (n=0..25); P27 PA27; P30 PA30; P31 PA31; P{n} PB{n-32:02} (n=32..57); P62 PB30; P63 PB31; P64 PC00; P65 PC01; P66 PC02; P67 PC03; P69 PC05; P70 PC06; P71 PC07; P{n} PC{n-64} (n=74..85); P88 PC24; P89 PC25; P90 PC26; P91 PC27; P92 PC28
  parameters: BITS=118, DRVSTR=1 (DRVSTR supported), EV_NUM=4, GROUPS=3, ODRAIN=0 (ODRAIN supported), SLEWLIM=0 (SLEWLIM supported), INSTANCE_ID=36
PUKCC
  parameters: RAM_ADDR_SIZE=12, ROM_ADDR_SIZE=16, INSTANCE_ID=76
QSPI at 0x42003400
  pins: CS PB11/H; DATA0 PA08/H; DATA1 PA09/H; DATA2 PA10/H; DATA3 PA11/H; SCK PB10/H
  parameters: DMAC_ID_RX=83, DMAC_ID_TX=84, HADDR_MSB=23, OCMS=1, INSTANCE_ID=77
RAMECC at 0x41020000
  parameters: RAMADDR_BITS=13 (Number of RAM address bits), RAMBANK_NUM=4 (Number of RAM banks), INSTANCE_ID=48
RSTC at 0x40000C00
  parameters: BACKUP_IMPLEMENTED=1, HIB_IMPLEMENTED=1, NUMBER_OF_EXTWAKE=0 (number of external wakeup line), NVMRST_IMPLEMENTED=1, INSTANCE_ID=3
RTC at 0x40002400
  pins: IN0 PB00; IN1 PB02; IN2 PA02; IN3 PC00; IN4 PC01; OUT PB01
  parameters: DMAC_ID_TIMESTAMP=1 (DMA RTC timestamp trigger), GPR_NUM=4 (Number of General-Purpose Registers), NUM_OF_ALARMS=2 (Number of Alarms), NUM_OF_BKREGS=8 (Number of Backup Registers), NUM_OF_COMP16=4 (Number of 16-bit Comparators), NUM_OF_COMP32=2 (Number of 32-bit Comparators), NUM_OF_TAMPERS=5 (Number of Tamper Inputs), PER_NUM=8 (Number of Periodic Intervals), INSTANCE_ID=9
SDHC0 at 0x45000000 (SDHC)
  pins: SDCD PA06/I or PA12/I or PB12/I or PC06/I; SDCK PB11/I; SDCMD PA08/I; SDDAT0 PA09/I; SDDAT1 PA10/I; SDDAT2 PA11/I; SDDAT3 PB10/I; SDWP PA07/I or PA13/I or PB13/I or PC07/I
  parameters: CARD_DATA_SIZE=4, GCLK_ID=45, GCLK_ID_SLOW=3, NB_OF_DEVICES=1, NB_REG_PVR=8, NB_REG_RR=4
SDHC1 at 0x46000000 (SDHC)
  pins: SDCD PB16/I or PC20/I; SDCK PA21/I; SDCMD PA20/I; SDDAT0 PB18/I; SDDAT1 PB19/I; SDDAT2 PB20/I; SDDAT3 PB21/I; SDWP PB17/I or PC21/I
  parameters: CARD_DATA_SIZE=4, GCLK_ID=46, GCLK_ID_SLOW=3, NB_OF_DEVICES=1, NB_REG_PVR=8, NB_REG_RR=4
SERCOM0 at 0x40003000 (SERCOM)
  pins: PAD0 PA04/D set 3 or PC17/D set 4 or PA08/C set 1 or PB24/C set 2; PAD1 PA05/D set 3 or PC16/D set 4 or PA09/C set 1 or PB25/C set 2; PAD2 PA06/D set 3 or PC18/D set 4 or PA10/C set 1 or PC24/C set 2; PAD3 PA07/D set 3 or PC19/D set 4 or PA11/C set 1 or PC25/C set 2
  parameters: CLK_REDUCTION=1 (Reduce clock options to pin 1 for SPI and USART), DLY_COMPENSATION=1 (Compensates for a fast DLY50 element. Assuming 20ns), DMA=1 (DMA support implemented?), DMAC_ID_RX=4 (Index of DMA RX trigger), DMAC_ID_TX=5 (Index of DMA TX trigger), FIFO_DEPTH_POWER=1 (2^FIFO_DEPTH_POWER gives rx FIFO depth.), GCLK_ID_CORE=7, GCLK_ID_SLOW=3, INT_MSB=6, PMSB=3, RETENTION_SUPPORT=0 (Retention supported?), SE_CNT=1 (SE counter included?), SPI=1 (SPI mode implemented?), SPI_HW_SS_CTRL=1 (Master _SS hardware control implemented?), SPI_ICSPACE_EXT=1 (SPI inter character space implemented?), SPI_OZMO=0 (OZMO features implemented?), SPI_WAKE_ON_SSL=1 (_SS low detect implemented?), TTBIT_EXTENSION=1 (32-bit extension implemented?), TWIM=1 (TWI Master mode implemented?), TWIS=1 (TWI Slave mode implemented?), TWIS_AUTO_ACK=1 (TWI slave automatic acknowledge implemented?), TWIS_GROUP_CMD=1 (TWI slave group command implemented?), TWIS_SDASETUP_CNT_SIZE=8 (TWIS sda setup count size), TWIS_SDASETUP_SIZE=4, TWIS_SUDAT=1 (TWI slave SDA setup implemented?), TWI_FASTMP=1 (TWI fast mode plus implemented?), TWI_HSMODE=1 (USART mode implemented?), TWI_SCLSM_MODE=1 (TWI SCL clock stretch mode implemented?), TWI_SMB_TIMEOUTS=1 (TWI SMBus timeouts implemented?), TWI_TENBIT_ADR=1 (TWI ten bit enabled?), USART=1 (USART mode implemented?), USART_AUTOBAUD=1 (USART autobaud implemented?), USART_COLDET=1 (USART collision detection implemented?), USART_FLOW_CTRL=1 (USART flow control implemented?), USART_FRAC_BAUD=1 (USART fractional BAUD implemented?), USART_IRDA=1 (USART IrDA implemented?), USART_ISO7816=1 (USART ISO7816 mode implemented?), USART_LIN_MASTER=1 (USART LIN Master mode implemented?), USART_RS485=1 (USART RS485 mode implemented?), USART_SAMPA_EXT=1 (USART sample adjust implemented?), USART_SAMPR_EXT=1 (USART oversampling adjustment implemented?), INSTANCE_ID=12
SERCOM1 at 0x40003400 (SERCOM)
  pins: PAD0 PA00/D set 4 or PA16/C set 1 or PC27/C set 3; PAD1 PA01/D set 4 or PA17/C set 1 or PC28/C set 3; PAD2 PA30/D set 4 or PA18/C set 1 or PB22/C set 3; PAD3 PA31/D set 4 or PA19/C set 1 or PB23/C set 3
  parameters: CLK_REDUCTION=1 (Reduce clock options to pin 1 for SPI and USART), DLY_COMPENSATION=1 (Compensates for a fast DLY50 element. Assuming 20ns), DMA=1 (DMA support implemented?), DMAC_ID_RX=6 (Index of DMA RX trigger), DMAC_ID_TX=7 (Index of DMA TX trigger), FIFO_DEPTH_POWER=1 (2^FIFO_DEPTH_POWER gives rx FIFO depth.), GCLK_ID_CORE=8, GCLK_ID_SLOW=3, INT_MSB=6, PMSB=3, RETENTION_SUPPORT=0 (Retention supported?), SE_CNT=1 (SE counter included?), SPI=1 (SPI mode implemented?), SPI_HW_SS_CTRL=1 (Master _SS hardware control implemented?), SPI_ICSPACE_EXT=1 (SPI inter character space implemented?), SPI_OZMO=0 (OZMO features implemented?), SPI_WAKE_ON_SSL=1 (_SS low detect implemented?), TTBIT_EXTENSION=1 (32-bit extension implemented?), TWIM=1 (TWI Master mode implemented?), TWIS=1 (TWI Slave mode implemented?), TWIS_AUTO_ACK=1 (TWI slave automatic acknowledge implemented?), TWIS_GROUP_CMD=1 (TWI slave group command implemented?), TWIS_SDASETUP_CNT_SIZE=8 (TWIS sda setup count size), TWIS_SDASETUP_SIZE=4, TWIS_SUDAT=1 (TWI slave SDA setup implemented?), TWI_FASTMP=1 (TWI fast mode plus implemented?), TWI_HSMODE=1 (USART mode implemented?), TWI_SCLSM_MODE=1 (TWI SCL clock stretch mode implemented?), TWI_SMB_TIMEOUTS=1 (TWI SMBus timeouts implemented?), TWI_TENBIT_ADR=1 (TWI ten bit enabled?), USART=1 (USART mode implemented?), USART_AUTOBAUD=1 (USART autobaud implemented?), USART_COLDET=1 (USART collision detection implemented?), USART_FLOW_CTRL=1 (USART flow control implemented?), USART_FRAC_BAUD=1 (USART fractional BAUD implemented?), USART_IRDA=1 (USART IrDA implemented?), USART_ISO7816=1 (USART ISO7816 mode implemented?), USART_LIN_MASTER=1 (USART LIN Master mode implemented?), USART_RS485=1 (USART RS485 mode implemented?), USART_SAMPA_EXT=1 (USART sample adjust implemented?), USART_SAMPR_EXT=1 (USART oversampling adjustment implemented?), INSTANCE_ID=13
SERCOM2 at 0x41012000 (SERCOM)
  pins: PAD0 PA09/D set 3 or PB25/D set 4 or PA12/C set 1; PAD1 PA08/D set 3 or PB24/D set 4 or PA13/C set 1; PAD2 PA10/D set 3 or PC24/D set 4 or PA14/C set 1; PAD3 PA11/D set 3 or PC25/D set 4 or PA15/C set 1
  parameters: CLK_REDUCTION=1 (Reduce clock options to pin 1 for SPI and USART), DLY_COMPENSATION=1 (Compensates for a fast DLY50 element. Assuming 20ns), DMA=1 (DMA support implemented?), DMAC_ID_RX=8 (Index of DMA RX trigger), DMAC_ID_TX=9 (Index of DMA TX trigger), FIFO_DEPTH_POWER=1 (2^FIFO_DEPTH_POWER gives rx FIFO depth.), GCLK_ID_CORE=23, GCLK_ID_SLOW=3, INT_MSB=6, PMSB=3, RETENTION_SUPPORT=0 (Retention supported?), SE_CNT=1 (SE counter included?), SPI=1 (SPI mode implemented?), SPI_HW_SS_CTRL=1 (Master _SS hardware control implemented?), SPI_ICSPACE_EXT=1 (SPI inter character space implemented?), SPI_OZMO=0 (OZMO features implemented?), SPI_WAKE_ON_SSL=1 (_SS low detect implemented?), TTBIT_EXTENSION=1 (32-bit extension implemented?), TWIM=1 (TWI Master mode implemented?), TWIS=1 (TWI Slave mode implemented?), TWIS_AUTO_ACK=1 (TWI slave automatic acknowledge implemented?), TWIS_GROUP_CMD=1 (TWI slave group command implemented?), TWIS_SDASETUP_CNT_SIZE=8 (TWIS sda setup count size), TWIS_SDASETUP_SIZE=4, TWIS_SUDAT=1 (TWI slave SDA setup implemented?), TWI_FASTMP=1 (TWI fast mode plus implemented?), TWI_HSMODE=1 (USART mode implemented?), TWI_SCLSM_MODE=1 (TWI SCL clock stretch mode implemented?), TWI_SMB_TIMEOUTS=1 (TWI SMBus timeouts implemented?), TWI_TENBIT_ADR=1 (TWI ten bit enabled?), USART=1 (USART mode implemented?), USART_AUTOBAUD=1 (USART autobaud implemented?), USART_COLDET=1 (USART collision detection implemented?), USART_FLOW_CTRL=1 (USART flow control implemented?), USART_FRAC_BAUD=1 (USART fractional BAUD implemented?), USART_IRDA=1 (USART IrDA implemented?), USART_ISO7816=1 (USART ISO7816 mode implemented?), USART_LIN_MASTER=1 (USART LIN Master mode implemented?), USART_RS485=1 (USART RS485 mode implemented?), USART_SAMPA_EXT=1 (USART sample adjust implemented?), USART_SAMPR_EXT=1 (USART oversampling adjustment implemented?), INSTANCE_ID=41
SERCOM3 at 0x41014000 (SERCOM)
  pins: PAD0 PA17/D set 3 or PA22/C set 1 or PB20/C set 2; PAD1 PA16/D set 3 or PA23/C set 1 or PB21/C set 2; PAD2 PA18/D set 3 or PA20/D set 2 or PA24/C set 1; PAD3 PA19/D set 3 or PA21/D set 2 or PA25/C set 1
  parameters: CLK_REDUCTION=1 (Reduce clock options to pin 1 for SPI and USART), DLY_COMPENSATION=1 (Compensates for a fast DLY50 element. Assuming 20ns), DMA=1 (DMA support implemented?), DMAC_ID_RX=10 (Index of DMA RX trigger), DMAC_ID_TX=11 (Index of DMA TX trigger), FIFO_DEPTH_POWER=1 (2^FIFO_DEPTH_POWER gives rx FIFO depth.), GCLK_ID_CORE=24, GCLK_ID_SLOW=3, INT_MSB=6, PMSB=3, RETENTION_SUPPORT=0 (Retention supported?), SE_CNT=1 (SE counter included?), SPI=1 (SPI mode implemented?), SPI_HW_SS_CTRL=1 (Master _SS hardware control implemented?), SPI_ICSPACE_EXT=1 (SPI inter character space implemented?), SPI_OZMO=0 (OZMO features implemented?), SPI_WAKE_ON_SSL=1 (_SS low detect implemented?), TTBIT_EXTENSION=1 (32-bit extension implemented?), TWIM=1 (TWI Master mode implemented?), TWIS=1 (TWI Slave mode implemented?), TWIS_AUTO_ACK=1 (TWI slave automatic acknowledge implemented?), TWIS_GROUP_CMD=1 (TWI slave group command implemented?), TWIS_SDASETUP_CNT_SIZE=8 (TWIS sda setup count size), TWIS_SDASETUP_SIZE=4, TWIS_SUDAT=1 (TWI slave SDA setup implemented?), TWI_FASTMP=1 (TWI fast mode plus implemented?), TWI_HSMODE=1 (USART mode implemented?), TWI_SCLSM_MODE=1 (TWI SCL clock stretch mode implemented?), TWI_SMB_TIMEOUTS=1 (TWI SMBus timeouts implemented?), TWI_TENBIT_ADR=1 (TWI ten bit enabled?), USART=1 (USART mode implemented?), USART_AUTOBAUD=1 (USART autobaud implemented?), USART_COLDET=1 (USART collision detection implemented?), USART_FLOW_CTRL=1 (USART flow control implemented?), USART_FRAC_BAUD=1 (USART fractional BAUD implemented?), USART_IRDA=1 (USART IrDA implemented?), USART_ISO7816=1 (USART ISO7816 mode implemented?), USART_LIN_MASTER=1 (USART LIN Master mode implemented?), USART_RS485=1 (USART RS485 mode implemented?), USART_SAMPA_EXT=1 (USART sample adjust implemented?), USART_SAMPR_EXT=1 (USART oversampling adjustment implemented?), INSTANCE_ID=42
SERCOM4 at 0x43000000 (SERCOM)
  pins: PAD0 PA13/D set 3 or PB08/D set 2 or PB12/C set 1; PAD1 PA12/D set 3 or PB09/D set 2 or PB13/C set 1; PAD2 PA14/D set 3 or PB10/D set 2 or PB14/C set 1; PAD3 PB11/D set 2 or PA15/D set 3 or PB15/C set 1
  parameters: CLK_REDUCTION=1 (Reduce clock options to pin 1 for SPI and USART), DLY_COMPENSATION=1 (Compensates for a fast DLY50 element. Assuming 20ns), DMA=1 (DMA support implemented?), DMAC_ID_RX=12 (Index of DMA RX trigger), DMAC_ID_TX=13 (Index of DMA TX trigger), FIFO_DEPTH_POWER=1 (2^FIFO_DEPTH_POWER gives rx FIFO depth.), GCLK_ID_CORE=34, GCLK_ID_SLOW=3, INT_MSB=6, PMSB=3, RETENTION_SUPPORT=0 (Retention supported?), SE_CNT=1 (SE counter included?), SPI=1 (SPI mode implemented?), SPI_HW_SS_CTRL=1 (Master _SS hardware control implemented?), SPI_ICSPACE_EXT=1 (SPI inter character space implemented?), SPI_OZMO=0 (OZMO features implemented?), SPI_WAKE_ON_SSL=1 (_SS low detect implemented?), TTBIT_EXTENSION=1 (32-bit extension implemented?), TWIM=1 (TWI Master mode implemented?), TWIS=1 (TWI Slave mode implemented?), TWIS_AUTO_ACK=1 (TWI slave automatic acknowledge implemented?), TWIS_GROUP_CMD=1 (TWI slave group command implemented?), TWIS_SDASETUP_CNT_SIZE=8 (TWIS sda setup count size), TWIS_SDASETUP_SIZE=4, TWIS_SUDAT=1 (TWI slave SDA setup implemented?), TWI_FASTMP=1 (TWI fast mode plus implemented?), TWI_HSMODE=1 (USART mode implemented?), TWI_SCLSM_MODE=1 (TWI SCL clock stretch mode implemented?), TWI_SMB_TIMEOUTS=1 (TWI SMBus timeouts implemented?), TWI_TENBIT_ADR=1 (TWI ten bit enabled?), USART=1 (USART mode implemented?), USART_AUTOBAUD=1 (USART autobaud implemented?), USART_COLDET=1 (USART collision detection implemented?), USART_FLOW_CTRL=1 (USART flow control implemented?), USART_FRAC_BAUD=1 (USART fractional BAUD implemented?), USART_IRDA=1 (USART IrDA implemented?), USART_ISO7816=1 (USART ISO7816 mode implemented?), USART_LIN_MASTER=1 (USART LIN Master mode implemented?), USART_RS485=1 (USART RS485 mode implemented?), USART_SAMPA_EXT=1 (USART sample adjust implemented?), USART_SAMPR_EXT=1 (USART oversampling adjustment implemented?), INSTANCE_ID=96
SERCOM5 at 0x43000400 (SERCOM)
  pins: PAD0 PA23/D set 2 3 4 or PB02/D set 6 or PB31/D set 5 or PB16/C set 1; PAD1 PA22/D set 2 3 4 or PB03/D set 6 or PB30/D set 5 or PB17/C set 1; PAD2 PA24/D set 3 or PB00/D set 5 6 or PB22/D set 4 or PA20/C set 2 or PB18/C set 1; PAD3 PA25/D set 3 or PB01/D set 5 6 or PB23/D set 4 or PA21/C set 2 or PB19/C set 1
  parameters: CLK_REDUCTION=1 (Reduce clock options to pin 1 for SPI and USART), DLY_COMPENSATION=1 (Compensates for a fast DLY50 element. Assuming 20ns), DMA=1 (DMA support implemented?), DMAC_ID_RX=14 (Index of DMA RX trigger), DMAC_ID_TX=15 (Index of DMA TX trigger), FIFO_DEPTH_POWER=1 (2^FIFO_DEPTH_POWER gives rx FIFO depth.), GCLK_ID_CORE=35, GCLK_ID_SLOW=3, INT_MSB=6, PMSB=3, RETENTION_SUPPORT=0 (Retention supported?), SE_CNT=1 (SE counter included?), SPI=1 (SPI mode implemented?), SPI_HW_SS_CTRL=1 (Master _SS hardware control implemented?), SPI_ICSPACE_EXT=1 (SPI inter character space implemented?), SPI_OZMO=0 (OZMO features implemented?), SPI_WAKE_ON_SSL=1 (_SS low detect implemented?), TTBIT_EXTENSION=1 (32-bit extension implemented?), TWIM=1 (TWI Master mode implemented?), TWIS=1 (TWI Slave mode implemented?), TWIS_AUTO_ACK=1 (TWI slave automatic acknowledge implemented?), TWIS_GROUP_CMD=1 (TWI slave group command implemented?), TWIS_SDASETUP_CNT_SIZE=8 (TWIS sda setup count size), TWIS_SDASETUP_SIZE=4, TWIS_SUDAT=1 (TWI slave SDA setup implemented?), TWI_FASTMP=1 (TWI fast mode plus implemented?), TWI_HSMODE=1 (USART mode implemented?), TWI_SCLSM_MODE=1 (TWI SCL clock stretch mode implemented?), TWI_SMB_TIMEOUTS=1 (TWI SMBus timeouts implemented?), TWI_TENBIT_ADR=1 (TWI ten bit enabled?), USART=1 (USART mode implemented?), USART_AUTOBAUD=1 (USART autobaud implemented?), USART_COLDET=1 (USART collision detection implemented?), USART_FLOW_CTRL=1 (USART flow control implemented?), USART_FRAC_BAUD=1 (USART fractional BAUD implemented?), USART_IRDA=1 (USART IrDA implemented?), USART_ISO7816=1 (USART ISO7816 mode implemented?), USART_LIN_MASTER=1 (USART LIN Master mode implemented?), USART_RS485=1 (USART RS485 mode implemented?), USART_SAMPA_EXT=1 (USART sample adjust implemented?), USART_SAMPR_EXT=1 (USART oversampling adjustment implemented?), INSTANCE_ID=97
SERCOM6 at 0x43000800 (SERCOM)
  pins: PAD0 PC13/D set 4 5 or PC16/C set 1; PAD1 PC12/D set 4 5 or PC05/C set 2 or PC17/C set 1; PAD2 PC14/D set 4 or PC06/C set 2 or PC10/C set 5 or PC18/C set 1; PAD3 PC15/D set 4 or PC07/C set 2 or PC11/C set 5 or PC19/C set 1
  parameters: CLK_REDUCTION=1 (Reduce clock options to pin 1 for SPI and USART), DLY_COMPENSATION=1 (Compensates for a fast DLY50 element. Assuming 20ns), DMA=1 (DMA support implemented?), DMAC_ID_RX=16 (Index of DMA RX trigger), DMAC_ID_TX=17 (Index of DMA TX trigger), FIFO_DEPTH_POWER=1 (2^FIFO_DEPTH_POWER gives rx FIFO depth.), GCLK_ID_CORE=36, GCLK_ID_SLOW=3, INT_MSB=6, PMSB=3, RETENTION_SUPPORT=0 (Retention supported?), SE_CNT=1 (SE counter included?), SPI=1 (SPI mode implemented?), SPI_HW_SS_CTRL=1 (Master _SS hardware control implemented?), SPI_ICSPACE_EXT=1 (SPI inter character space implemented?), SPI_OZMO=0 (OZMO features implemented?), SPI_WAKE_ON_SSL=1 (_SS low detect implemented?), TTBIT_EXTENSION=1 (32-bit extension implemented?), TWIM=1 (TWI Master mode implemented?), TWIS=1 (TWI Slave mode implemented?), TWIS_AUTO_ACK=1 (TWI slave automatic acknowledge implemented?), TWIS_GROUP_CMD=1 (TWI slave group command implemented?), TWIS_SDASETUP_CNT_SIZE=8 (TWIS sda setup count size), TWIS_SDASETUP_SIZE=4, TWIS_SUDAT=1 (TWI slave SDA setup implemented?), TWI_FASTMP=1 (TWI fast mode plus implemented?), TWI_HSMODE=1 (USART mode implemented?), TWI_SCLSM_MODE=1 (TWI SCL clock stretch mode implemented?), TWI_SMB_TIMEOUTS=1 (TWI SMBus timeouts implemented?), TWI_TENBIT_ADR=1 (TWI ten bit enabled?), USART=1 (USART mode implemented?), USART_AUTOBAUD=1 (USART autobaud implemented?), USART_COLDET=1 (USART collision detection implemented?), USART_FLOW_CTRL=1 (USART flow control implemented?), USART_FRAC_BAUD=1 (USART fractional BAUD implemented?), USART_IRDA=1 (USART IrDA implemented?), USART_ISO7816=1 (USART ISO7816 mode implemented?), USART_LIN_MASTER=1 (USART LIN Master mode implemented?), USART_RS485=1 (USART RS485 mode implemented?), USART_SAMPA_EXT=1 (USART sample adjust implemented?), USART_SAMPR_EXT=1 (USART oversampling adjustment implemented?), INSTANCE_ID=98
SERCOM7 at 0x43000C00 (SERCOM)
  pins: PAD0 PB21/D set 4 or PB30/C set 5 or PC12/C set 1 3; PAD1 PB20/D set 4 or PB31/C set 5 or PC13/C set 1 3; PAD2 PB18/D set 4 or PC10/D set 3 or PC14/C set 1 or PA30/C set 5; PAD3 PB19/D set 4 or PC11/D set 3 or PC15/C set 1 or PA31/C set 5
  parameters: CLK_REDUCTION=1 (Reduce clock options to pin 1 for SPI and USART), DLY_COMPENSATION=1 (Compensates for a fast DLY50 element. Assuming 20ns), DMA=1 (DMA support implemented?), DMAC_ID_RX=18 (Index of DMA RX trigger), DMAC_ID_TX=19 (Index of DMA TX trigger), FIFO_DEPTH_POWER=1 (2^FIFO_DEPTH_POWER gives rx FIFO depth.), GCLK_ID_CORE=37, GCLK_ID_SLOW=3, INT_MSB=6, PMSB=3, RETENTION_SUPPORT=0 (Retention supported?), SE_CNT=1 (SE counter included?), SPI=1 (SPI mode implemented?), SPI_HW_SS_CTRL=1 (Master _SS hardware control implemented?), SPI_ICSPACE_EXT=1 (SPI inter character space implemented?), SPI_OZMO=0 (OZMO features implemented?), SPI_WAKE_ON_SSL=1 (_SS low detect implemented?), TTBIT_EXTENSION=1 (32-bit extension implemented?), TWIM=1 (TWI Master mode implemented?), TWIS=1 (TWI Slave mode implemented?), TWIS_AUTO_ACK=1 (TWI slave automatic acknowledge implemented?), TWIS_GROUP_CMD=1 (TWI slave group command implemented?), TWIS_SDASETUP_CNT_SIZE=8 (TWIS sda setup count size), TWIS_SDASETUP_SIZE=4, TWIS_SUDAT=1 (TWI slave SDA setup implemented?), TWI_FASTMP=1 (TWI fast mode plus implemented?), TWI_HSMODE=1 (USART mode implemented?), TWI_SCLSM_MODE=1 (TWI SCL clock stretch mode implemented?), TWI_SMB_TIMEOUTS=1 (TWI SMBus timeouts implemented?), TWI_TENBIT_ADR=1 (TWI ten bit enabled?), USART=1 (USART mode implemented?), USART_AUTOBAUD=1 (USART autobaud implemented?), USART_COLDET=1 (USART collision detection implemented?), USART_FLOW_CTRL=1 (USART flow control implemented?), USART_FRAC_BAUD=1 (USART fractional BAUD implemented?), USART_IRDA=1 (USART IrDA implemented?), USART_ISO7816=1 (USART ISO7816 mode implemented?), USART_LIN_MASTER=1 (USART LIN Master mode implemented?), USART_RS485=1 (USART RS485 mode implemented?), USART_SAMPA_EXT=1 (USART sample adjust implemented?), USART_SAMPR_EXT=1 (USART oversampling adjustment implemented?), INSTANCE_ID=99
SUPC at 0x40001800
  pins: OUT0 PB01 set 1; OUT1 PB02 set 1; VBAT PB03 set 1
  parameters: BOD12_CALIB_MSB=5, BOD33_CALIB_MSB=5, INSTANCE_ID=6
TC0 at 0x40003800 (TC)
  pins: WO0 PA04/E set 1 or PA08/E set 2 or PB30/E set 3; WO1 PA05/E set 1 or PA09/E set 2 or PB31/E set 3
  parameters: CC_NUM=2, DMAC_ID_OVF=44 (Indexes of DMA Overflow trigger), EXT=0 (Coding of implemented extended features (keep 0 value)), GCLK_ID=9 (Index of Generic Clock), MASTER_SLAVE_MODE=1 (TC type 0 : NA, 1 : Master, 2 : Slave), OW_NUM=2 (Number of Output Waveforms), INSTANCE_ID=14
TC1 at 0x40003C00 (TC)
  pins: WO0 PA06/E set 1 or PA10/E set 2; WO1 PA07/E set 1 or PA11/E set 2
  parameters: CC_NUM=2, DMAC_ID_OVF=47 (Indexes of DMA Overflow trigger), EXT=0 (Coding of implemented extended features (keep 0 value)), GCLK_ID=9 (Index of Generic Clock), MASTER_SLAVE_MODE=2 (TC type 0 : NA, 1 : Master, 2 : Slave), OW_NUM=2 (Number of Output Waveforms), INSTANCE_ID=15
TC2 at 0x4101A000 (TC)
  pins: WO0 PA12/E set 2 or PA16/E set 3 or PA00/E set 1; WO1 PA01/E set 1 or PA13/E set 2 or PA17/E set 3
  parameters: CC_NUM=2, DMAC_ID_OVF=50 (Indexes of DMA Overflow trigger), EXT=0 (Coding of implemented extended features (keep 0 value)), GCLK_ID=26 (Index of Generic Clock), MASTER_SLAVE_MODE=1 (TC type 0 : NA, 1 : Master, 2 : Slave), OW_NUM=2 (Number of Output Waveforms), INSTANCE_ID=45
TC3 at 0x4101C000 (TC)
  pins: WO0 PA18/E set 2 or PA14/E set 1; WO1 PA15/E set 1 or PA19/E set 2
  parameters: CC_NUM=2, DMAC_ID_OVF=53 (Indexes of DMA Overflow trigger), EXT=0 (Coding of implemented extended features (keep 0 value)), GCLK_ID=26 (Index of Generic Clock), MASTER_SLAVE_MODE=2 (TC type 0 : NA, 1 : Master, 2 : Slave), OW_NUM=2 (Number of Output Waveforms), INSTANCE_ID=46
TC4 at 0x42001400 (TC)
  pins: WO0 PA22/E set 3 or PB08/E set 1 or PB12/E set 2; WO1 PA23/E set 3 or PB09/E set 1 or PB13/E set 2
  parameters: CC_NUM=2, DMAC_ID_OVF=56 (Indexes of DMA Overflow trigger), EXT=0 (Coding of implemented extended features (keep 0 value)), GCLK_ID=30 (Index of Generic Clock), MASTER_SLAVE_MODE=1 (TC type 0 : NA, 1 : Master, 2 : Slave), OW_NUM=2 (Number of Output Waveforms), INSTANCE_ID=69
TC5 at 0x42001800 (TC)
  pins: WO0 PA24/E set 3 or PB10/E set 1 or PB14/E set 2; WO1 PA25/E set 3 or PB11/E set 1 or PB15/E set 2
  parameters: CC_NUM=2, DMAC_ID_OVF=59 (Indexes of DMA Overflow trigger), EXT=0 (Coding of implemented extended features (keep 0 value)), GCLK_ID=30 (Index of Generic Clock), MASTER_SLAVE_MODE=2 (TC type 0 : NA, 1 : Master, 2 : Slave), OW_NUM=2 (Number of Output Waveforms), INSTANCE_ID=70
TC6 at 0x43001400 (TC)
  pins: WO0 PA30/E set 2 or PB02/E set 3 or PB16/E set 1; WO1 PA31/E set 3 or PB03/E set 1 or PB17/E set 2
  parameters: CC_NUM=2, DMAC_ID_OVF=62 (Indexes of DMA Overflow trigger), EXT=0 (Coding of implemented extended features (keep 0 value)), GCLK_ID=39 (Index of Generic Clock), MASTER_SLAVE_MODE=1 (TC type 0 : NA, 1 : Master, 2 : Slave), OW_NUM=2 (Number of Output Waveforms), INSTANCE_ID=101
TC7 at 0x43001800 (TC)
  pins: WO0 PA20/E set 1 or PB00/E set 3 or PB22/E set 2; WO1 PA21/E set 1 or PB01/E set 3 or PB23/E set 2
  parameters: CC_NUM=2, DMAC_ID_OVF=65 (Indexes of DMA Overflow trigger), EXT=0 (Coding of implemented extended features (keep 0 value)), GCLK_ID=39 (Index of Generic Clock), MASTER_SLAVE_MODE=2 (TC type 0 : NA, 1 : Master, 2 : Slave), OW_NUM=2 (Number of Output Waveforms), INSTANCE_ID=102
TCC0 at 0x41016000 (TCC)
  pins: WO0 PA20/G set 6 or PB12/G set 5 or PA08/F set 1 or PC10/F set 3 or PC16/F set 4; WO1 PA21/G set 6 or PB13/G set 5 or PA09/F set 1 or PC11/F set 3 or PC17/F set 4; WO2 PA22/G set 6 or PB14/G set 5 or PA10/F set 1 or PC12/F set 3 or PC18/F set 4; WO3 PA23/G set 6 or PB15/G set 5 or PA11/F set 1 or PC13/F set 3 or PC19/F set 4; WO4 PA16/G set 5 or PB16/G set 6 or PB10/F set 1 or PC14/F set 3 or PC20/F set 4; WO5 PA17/G set 5 or PB17/G set 6 or PB11/F set 1 or PC15/F set 3 or PC21/F set 4; WO6 PA18/G set 3 or PB30/G set 4 or PA12/F set 1; WO7 PA19/G set 3 or PB31/G set 4 or PA13/F set 1
  parameters: CC_NUM=6 (Number of Compare/Capture units), DITHERING=1 (Dithering feature implemented), DMAC_ID_OVF=22 (DMA overflow/underflow/retrigger trigger), DTI=1 (Dead-Time-Insertion feature implemented), EXT=31 (Coding of implemented extended features), GCLK_ID=25 (Index of Generic Clock), MASTER_SLAVE_MODE=1 (TCC type 0 : NA, 1 : Master, 2 : Slave), OTMX=1 (Output Matrix feature implemented), OW_NUM=8 (Number of Output Waveforms), PG=1 (Pattern Generation feature implemented), SIZE=24, SWAP=1 (DTI outputs swap feature implemented), INSTANCE_ID=43
TCC1 at 0x41018000 (TCC)
  pins: WO0 PB10/G set 4 or PC14/G set 5 or PA16/F set 1 or PB18/F set 3; WO1 PB11/G set 4 or PC15/G set 5 or PA17/F set 1 or PB19/F set 3; WO2 PA12/G set 4 or PA14/G set 5 or PA18/F set 1 or PB20/F set 2; WO3 PA13/G set 4 or PA15/G set 5 or PA19/F set 1 or PB21/F set 2; WO4 PA08/G set 3 or PC10/G set 4 or PA20/F set 1; WO5 PA09/G set 3 or PC11/G set 4 or PA21/F set 1; WO6 PA10/G set 2 or PC12/G set 3 or PA22/F set 1; WO7 PA11/G set 2 or PC13/G set 3 or PA23/F set 1
  parameters: CC_NUM=4 (Number of Compare/Capture units), DITHERING=1 (Dithering feature implemented), DMAC_ID_OVF=29 (DMA overflow/underflow/retrigger trigger), DTI=1 (Dead-Time-Insertion feature implemented), EXT=31 (Coding of implemented extended features), GCLK_ID=25 (Index of Generic Clock), MASTER_SLAVE_MODE=2 (TCC type 0 : NA, 1 : Master, 2 : Slave), OTMX=1 (Output Matrix feature implemented), OW_NUM=8 (Number of Output Waveforms), PG=1 (Pattern Generation feature implemented), SIZE=24, SWAP=1 (DTI outputs swap feature implemented), INSTANCE_ID=44
TCC2 at 0x42000C00 (TCC)
  pins: WO0 PA14/F set 1 or PA30/F set 2; WO1 PA15/F set 1 or PA31/F set 2; WO2 PA24/F set 1 or PB02/F set 2
  parameters: CC_NUM=3 (Number of Compare/Capture units), DITHERING=0 (Dithering feature implemented), DMAC_ID_OVF=34 (DMA overflow/underflow/retrigger trigger), DTI=0 (Dead-Time-Insertion feature implemented), EXT=1 (Coding of implemented extended features), GCLK_ID=29 (Index of Generic Clock), MASTER_SLAVE_MODE=0 (TCC type 0 : NA, 1 : Master, 2 : Slave), OTMX=1 (Output Matrix feature implemented), OW_NUM=3 (Number of Output Waveforms), PG=0 (Pattern Generation feature implemented), SIZE=16, SWAP=0 (DTI outputs swap feature implemented), INSTANCE_ID=67
TCC3 at 0x42001000 (TCC)
  pins: WO0 PB12/F set 1 or PB16/F set 2; WO1 PB13/F set 1 or PB17/F set 2
  parameters: CC_NUM=2 (Number of Compare/Capture units), DITHERING=0 (Dithering feature implemented), DMAC_ID_OVF=38 (DMA overflow/underflow/retrigger trigger), DTI=0 (Dead-Time-Insertion feature implemented), EXT=0 (Coding of implemented extended features), GCLK_ID=29 (Index of Generic Clock), MASTER_SLAVE_MODE=0 (TCC type 0 : NA, 1 : Master, 2 : Slave), OTMX=0 (Output Matrix feature implemented), OW_NUM=2 (Number of Output Waveforms), PG=0 (Pattern Generation feature implemented), SIZE=16, SWAP=0 (DTI outputs swap feature implemented), INSTANCE_ID=68
TCC4 at 0x43001000 (TCC)
  pins: WO0 PB14/F set 1 or PB30/F set 2; WO1 PB15/F set 1 or PB31/F set 2
  parameters: CC_NUM=2 (Number of Compare/Capture units), DITHERING=0 (Dithering feature implemented), DMAC_ID_OVF=41 (DMA overflow/underflow/retrigger trigger), DTI=0 (Dead-Time-Insertion feature implemented), EXT=0 (Coding of implemented extended features), GCLK_ID=38 (Index of Generic Clock), MASTER_SLAVE_MODE=0 (TCC type 0 : NA, 1 : Master, 2 : Slave), OTMX=0 (Output Matrix feature implemented), OW_NUM=2 (Number of Output Waveforms), PG=0 (Pattern Generation feature implemented), SIZE=16, SWAP=0 (DTI outputs swap feature implemented), INSTANCE_ID=100
TRNG at 0x42002800
  parameters: INSTANCE_ID=74
USB at 0x41000000
  pins: DM PA24/H; DP PA25/H; SOF_1KHZ PA23/H set 1 or PB22/H set 2
  parameters: AHB_2_USB_FIFO_DEPTH=4 (bytes number, should be at least 2, and 2^n (4,8,16 ...)), AHB_2_USB_RD_DATA_BITS=8 (8, 16 or 32, here : 8-bits is required as UTMI interface should work in 8-bits mode), AHB_2_USB_WR_DATA_BITS=32 (8, 16 or 32 : here, AHB transfer is made in word mode), AHB_2_USB_WR_THRESHOLD=2 (as soon as there are N bytes-free inside the fifo, ahb read transfer is requested), DATA_BUS_16_8=0 (UTMI/SIE data bus size : 0 -> 8 bits, 1 -> 16 bits), EPNUM=8 (parameter for rtl : max of ENDPOINT and PIPE NUM), EPT_NUM=8 (Number of USB end points), GCLK_ID=10 (Index of Generic Clock), INITIAL_CONTROL_QOS=3 (CONTROL QOS RESET value), INITIAL_DATA_QOS=3 (DATA QOS RESET value), MISSING_SOF_DET_IMPLEMENTED=1 (48 mHz xPLL feature implemented), PIPE_NUM=8 (Number of USB pipes), SYSTEM_CLOCK_IS_CKUSB=0 (Dual (1'b0) or Single (1'b1) clock system), USB_2_AHB_FIFO_DEPTH=4 (bytes number, should be at least 2, and 2^n (4,8,16 ...)), USB_2_AHB_RD_DATA_BITS=16 (8, 16 or 32, here : 8-bits is required as UTMI interface should work in 8-bits mode), USB_2_AHB_RD_THRESHOLD=2 (as soon as there are 16 bytes-free inside the fifo, ahb read transfer is requested), USB_2_AHB_WR_DATA_BITS=8 (8, 16 or 32 : here : 8-bits is required as UTMI interface should work in 8-bits mode), INSTANCE_ID=32
WDT at 0x40002000
  parameters: INSTANCE_ID=8
CoreDebug at 0xE000EDF0
DWT at 0xE0001000
ETM at 0xE0041000
FPU at 0xE000EF30
ITM at 0xE0041000
MPU at 0xE000ED90
NVIC at 0xE000E100
  parameters: NUM_IRQ=137 (Number of interrupt requests), __NVIC_PRIO_BITS=3 (Number of NVIC interrupt priority bits)
SysTick at 0xE000E010
SystemControl at 0xE000E000
TPI at 0xE0040000

## Interrupts
-15 Reset — Reset Vector, invoked on Power up and warm reset
-14 NonMaskableInt — Non maskable Interrupt, cannot be stopped or preempted
-13 HardFault — Hard Fault, all classes of Fault
-12 MemoryManagement — Memory Management, MPU mismatch, including Access Violation and No Match
-11 BusFault — Bus Fault, Pre-Fetch-, Memory Access Fault, other address/memory related Fault
-10 UsageFault — Usage Fault, i.e. Undef Instruction, Illegal State Transition
-5 SVCall — System Service Call via SVC instruction
-4 DebugMonitor
-2 PendSV — Pendable request for system service
-1 SysTick — System Tick Timer
0 PM
1 MCLK
2 OSCCTRL_XOSC0 (OSCCTRL)
3 OSCCTRL_XOSC1 (OSCCTRL)
4 OSCCTRL_DFLL (OSCCTRL)
5 OSCCTRL_DPLL0 (OSCCTRL)
6 OSCCTRL_DPLL1 (OSCCTRL)
7 OSC32KCTRL
8 SUPC_OTHER (SUPC)
9 SUPC_BODDET (SUPC)
10 WDT
11 RTC
{n+12} EIC_EXTINT_{n} (EIC) (n=0..15)
28 FREQM
29 NVMCTRL_0 (NVMCTRL)
30 NVMCTRL_1 (NVMCTRL)
31 DMAC_0 (DMAC)
32 DMAC_1 (DMAC)
33 DMAC_2 (DMAC)
34 DMAC_3 (DMAC)
35 DMAC_OTHER (DMAC)
36 EVSYS_0 (EVSYS)
37 EVSYS_1 (EVSYS)
38 EVSYS_2 (EVSYS)
39 EVSYS_3 (EVSYS)
40 EVSYS_OTHER (EVSYS)
41 PAC
45 RAMECC
{4n+46} SERCOM{n}_0 (SERCOM{n}) (n=0..7)
{4n+47} SERCOM{n}_1 (SERCOM{n}) (n=0..7)
{4n+48} SERCOM{n}_2 (SERCOM{n}) (n=0..7)
{4n+49} SERCOM{n}_OTHER (SERCOM{n}) (n=0..7)
80 USB_OTHER (USB)
81 USB_SOF_HSOF (USB)
82 USB_TRCPT0 (USB)
83 USB_TRCPT1 (USB)
84 GMAC
85 TCC0_OTHER (TCC0)
86 TCC0_MC0 (TCC0)
87 TCC0_MC1 (TCC0)
88 TCC0_MC2 (TCC0)
89 TCC0_MC3 (TCC0)
90 TCC0_MC4 (TCC0)
91 TCC0_MC5 (TCC0)
92 TCC1_OTHER (TCC1)
93 TCC1_MC0 (TCC1)
94 TCC1_MC1 (TCC1)
95 TCC1_MC2 (TCC1)
96 TCC1_MC3 (TCC1)
97 TCC2_OTHER (TCC2)
98 TCC2_MC0 (TCC2)
99 TCC2_MC1 (TCC2)
100 TCC2_MC2 (TCC2)
101 TCC3_OTHER (TCC3)
102 TCC3_MC0 (TCC3)
103 TCC3_MC1 (TCC3)
104 TCC4_OTHER (TCC4)
105 TCC4_MC0 (TCC4)
106 TCC4_MC1 (TCC4)
{n+107} TC{n} (n=0..7)
115 PDEC_OTHER (PDEC)
116 PDEC_MC0 (PDEC)
117 PDEC_MC1 (PDEC)
118 ADC0_OTHER (ADC0)
119 ADC0_RESRDY (ADC0)
120 ADC1_OTHER (ADC1)
121 ADC1_RESRDY (ADC1)
122 AC
123 DAC_OTHER (DAC)
124 DAC_EMPTY_0 (DAC)
125 DAC_EMPTY_1 (DAC)
126 DAC_RESRDY_0 (DAC)
127 DAC_RESRDY_1 (DAC)
128 I2S
129 PCC
130 AES
131 TRNG
132 ICM
133 PUKCC
134 QSPI
135 SDHC0
136 SDHC1

## Event generators
1 OSCCTRL_XOSC_FAIL_0, 2 OSCCTRL_XOSC_FAIL_1, 3 OSC32KCTRL_XOSC32K_FAIL, {n+4} RTC_PER_{n} (n=0..7), {n+12} RTC_CMP_{n} (n=0..3), 16 RTC_TAMPER, 17 RTC_OVF, {n+18} EIC_EXTINT_{n} (n=0..15), {n+34} DMAC_CH_{n} (n=0..3), 38 PAC_ACCERR, 41 TCC0_OVF, 42 TCC0_TRG, 43 TCC0_CNT, {n+44} TCC0_MCX_{n} (n=0..5), 50 TCC1_OVF, 51 TCC1_TRG, 52 TCC1_CNT, {n+53} TCC1_MCX_{n} (n=0..3), 57 TCC2_OVF, 58 TCC2_TRG, 59 TCC2_CNT, {n+60} TCC2_MCX_{n} (n=0..2), 63 TCC3_OVF, 64 TCC3_TRG, 65 TCC3_CNT, 66 TCC3_MCX_0, 67 TCC3_MCX_1, 68 TCC4_OVF, 69 TCC4_TRG, 70 TCC4_CNT, 71 TCC4_MCX_0, 72 TCC4_MCX_1, {3n+73} TC{n}_OVF (n=0..7), {3n+74} TC{n}_MCX_0 (n=0..7), {3n+75} TC{n}_MCX_1 (n=0..7), 97 PDEC_OVF, 98 PDEC_ERR, 99 PDEC_DIR, 100 PDEC_VLC, 101 PDEC_MCX_0, 102 PDEC_MCX_1, 103 ADC0_RESRDY, 104 ADC0_WINMON, 105 ADC1_RESRDY, 106 ADC1_WINMON, 107 AC_COMP_0, 108 AC_COMP_1, 109 AC_WIN_0, 110 DAC_EMPTY_0, 111 DAC_EMPTY_1, 112 DAC_RESRDY_0, 113 DAC_RESRDY_1, 114 GMAC_TSU_CMP, 115 TRNG_READY, {n+116} CCL_LUTOUT_{n} (n=0..3)

## Event users
0 RTC_TAMPER, {n+1} PORT_EV_{n} (n=0..3), {n+5} DMAC_CH_{n} (n=0..7), 14 CM4_TRACE_START, 15 CM4_TRACE_STOP, 16 CM4_TRACE_TRIG, 17 TCC0_EV_0, 18 TCC0_EV_1, {n+19} TCC0_MC_{n} (n=0..5), 25 TCC1_EV_0, 26 TCC1_EV_1, {n+27} TCC1_MC_{n} (n=0..3), 31 TCC2_EV_0, 32 TCC2_EV_1, {n+33} TCC2_MC_{n} (n=0..2), 36 TCC3_EV_0, 37 TCC3_EV_1, 38 TCC3_MC_0, 39 TCC3_MC_1, 40 TCC4_EV_0, 41 TCC4_EV_1, 42 TCC4_MC_0, 43 TCC4_MC_1, {n+44} TC{n}_EVU (n=0..7), {n+52} PDEC_EVU_{n} (n=0..2), 55 ADC0_START, 56 ADC0_SYNC, 57 ADC1_START, 58 ADC1_SYNC, 59 AC_SOC_0, 60 AC_SOC_1, 61 DAC_START_0, 62 DAC_START_1, {n+63} CCL_LUTIN_{n} (n=0..3)

## Properties
SIGNATURES: DSU_DID=0x61830202

## Pinouts (pin number, pad)
SAMD51N: 1 PA00, 2 PA01, 3 PC00, 4 PC01, 5 PC02, 6 PC03, 7 PA02, 8 PA03, 9 PB04, 10 PB05, 11 GNDANA, 12 VDDANA, 13 PB06, 14 PB07, 15 PB08, 16 PB09, 17 PA04, 18 PA05, 19 PA06, 20 PA07, 21 PC05, 22 PC06, 23 PC07, 24 GND, 25 VDDIO, 26 PA08, 27 PA09, 28 PA10, 29 PA11, 30 VDDIO, 31 GND, 32 PB10, 33 PB11, 34 PB12, 35 PB13, 36 PB14, 37 PB15, 38 GND, 39 VDDIO, 40 PC10, 41 PC11, 42 PC12, 43 PC13, 44 PC14, 45 PC15, 46 PA12, 47 PA13, 48 PA14, 49 PA15, 50 GND, 51 VDDIO, 52 PA16, 53 PA17, 54 PA18, 55 PA19, 56 PC16, 57 PC17, 58 PC18, 59 PC19, 60 PC20, 61 PC21, 62 GND, 63 VDDIO, 64 PB16, 65 PB17, 66 PB18, 67 PB19, 68 PB20, 69 PB21, 70 PA20, 71 PA21, 72 PA22, 73 PA23, 74 PA24, 75 PA25, 76 GND, 77 VDDIO, 78 PB22, 79 PB23, 80 PB24, 81 PB25, 82 PC24, 83 PC25, 84 PC26, 85 PC27, 86 PC28, 87 PA27, 88 RESET_N, 89 VDDCORE, 90 GND, 91 VSW, 92 VDDIO, 93 PA30, 94 PA31, 95 PB30, 96 PB31, 97 PB00, 98 PB01, 99 PB02, 100 PB03

## Notices in the file
Copyright (c) 2018 Microchip Technology Inc.
SPDX-License-Identifier: Apache-2.0
Licensed under the Apache License, Version 2.0 (the "License");
you may not use this file except in compliance with the License.
You may obtain a copy of the License at
http://www.apache.org/licenses/LICENSE-2.0
Unless required by applicable law or agreed to in writing, software
distributed under the License is distributed on an "AS IS" BASIS,
WITHOUT WARRANTIES OR CONDITIONS OF ANY KIND, either express or implied.
See the License for the specific language governing permissions and
limitations under the License.
